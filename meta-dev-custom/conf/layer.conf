## meta-dev-custom/conf/layer.conf
```bitbake
# We have a conf and classes directory, add to BBPATH
BBPATH .= ":${LAYERDIR}"

# We have recipes-* directories, add to BBFILES
BBFILES += "${LAYERDIR}/recipes-*/*/*.bb \
            ${LAYERDIR}/recipes-*/*/*.bbappend"

BBFILE_COLLECTIONS += "meta-dev-custom"
BBFILE_PATTERN_meta-dev-custom = "^${LAYERDIR}/"
BBFILE_PRIORITY_meta-dev-custom = "6"

LAYERDEPENDS_meta-dev-custom = "core"
LAYERSERIES_COMPAT_meta-dev-custom = "wrynose"
```
